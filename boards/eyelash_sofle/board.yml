## boards/eyelash_sofle/board.yml
```yaml
board:
  name: eyelash_sofle
  vendor: eyelashperipherals
  socs:
    - name: nrf52840_qiaa
      variants:
        - name: left
        - name: right
```

## boards/eyelashperipherals/eyelash_sofle/board.yml
```yaml
board:
  name: eyelash_sofle
  vendor: eyelashperipherals
  socs:
    - name: nrf52840
      variants:
        - name: left
        - name: right
```
